## build/conf/bblayers.conf
```bitbake
# POKY_BBLAYERS_CONF_VERSION is increased each time build/conf/bblayers.conf
# changes incompatibly
POKY_BBLAYERS_CONF_VERSION = "2"

BBPATH = "${TOPDIR}"
BBFILES ?= ""

BBLAYERS ?= " \
  /home/student/real_time/7/poky/meta \
  /home/student/real_time/7/poky/meta-poky \
  /home/student/real_time/7/poky/meta-yocto-bsp \
  /home/student/real_time/7/meta-xilinx/meta-xilinx-bsp \
  /home/student/real_time/7/meta-xilinx/meta-xilinx-contrib \
  /home/student/real_time/7/meta-pynq \
  /home/student/real_time/7/meta-group7 \
  /home/student/real_time/7/meta-LKM \
  /home/student/real_time/7/meta-tie50307 \
  "
```

## meta-group7/conf/layer.conf
```bitbake
# We have a conf and classes directory, add to BBPATH
BBPATH .= ":${LAYERDIR}"

# We have recipes-* directories, add to BBFILES
BBFILES += "${LAYERDIR}/recipes-*/*/*.bb \
	${LAYERDIR}/recipes-*/*/*.bbappend"

BBFILE_COLLECTIONS += "group7"
BBFILE_PATTERN_group7 = "^${LAYERDIR}/"
BBFILE_PRIORITY_group7 = "5"
```

## meta-pynq/conf/layer.conf
```bitbake
# We have a conf and classes directory, add to BBPATH
BBPATH .= ":${LAYERDIR}"

# We have a packages directory, add to BBFILES
BBFILES += "${LAYERDIR}/recipes-*/*/*.bb"
BBFILES += "${LAYERDIR}/recipes-*/*/*.bbappend"

BBFILE_COLLECTIONS += "pynq"
BBFILE_PATTERN_pynq = "^${LAYERDIR}/"
BBFILE_PRIORITY_pynq = "5"

LAYERDEPENDS_pynq = "core"
```

## meta-pynq/conf/machine/pynq.conf
```bitbake
#@TYPE: Machine
#@NAME: pynq
#@DESCRIPTION: Machine support for PynQ.

require conf/machine/include/tune-zynq.inc
require conf/machine/include/machine-xilinx-default.inc
require conf/machine/include/machine-xilinx-board.inc

MACHINE_FEATURES = "ext2 vfat usbhost"

# u-boot configuration
PREFERRED_PROVIDER_virtual/bootloader = "u-boot-digilent"
UBOOT_MACHINE = "zynq_artyz7_config"
SPL_BINARY = "spl/boot.bin"

EXTRA_IMAGEDEPENDS += " \
		u-boot-pynq-uenv \
		virtual/bootloader \
		"

SERIAL_CONSOLE = "115200 ttyPS0"

MACHINE_ESSENTIAL_EXTRA_RDEPENDS += "device-tree"

IMAGE_BOOT_FILES += " \
		boot.bin \
		${MACHINE}.dtb \
		uEnv.txt \
		"
```
